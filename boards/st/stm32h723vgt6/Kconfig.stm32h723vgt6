## boards/st/stm32h723vgt6/Kconfig.stm32h723vgt6
```kconfig
# Copyright (c) 2026 blinky project
# SPDX-License-Identifier: Apache-2.0

# Custom board for STM32H723VGT6
config BOARD_STM32H723VGT6
	select SOC_STM32H723XX
```

## boards/st/stm32h723vgt6/board.yml
```yaml
board:
  name: stm32h723vgt6
  full_name: Custom STM32H723VGT6 Board
  vendor: st
  socs:
    - name: stm32h723xx
```

## framework/algorithm/Kconfig
```kconfig
# algorithm/Kconfig — 算法与控制器
# 提供 PID/功率控制/滤波器/参数辨识等计算模块
# 不直接依赖硬件，可在仿真或离线环境中使用
# 头文件在 algorithm/controller/ 和 algorithm/identify/ 下

config DUST_BUF_BIPBUF
	bool "双区环形缓冲区"
	default n
	help
	    双区环形缓冲区（BipBuffer），保证可读块连续，零拷贝 DMA 友好。

config DUST_BUF_RINGBUF
	bool "环形缓冲区"
	default n
	help
	    环形缓冲区（Ring Buffer），固定内存池 FIFO。
	    写满时丢弃新数据，保留一格区分空/满。

config DUST_CTL_EXECTIMER
    bool "ExecTimer"
    default n
    help
        代码段执行时间测量工具，支持多节点分段计时。

config DUST_CTL_PID
    bool "PID控制器"
    default n
    help
        位置式PID控制器，支持微分先行/积分分离/变速积分/D项低通滤波

config DUST_CTL_TIMER
    bool "软件定时器"
    default n
    help
        软件定时器

config DUST_FLT_HPF
    bool "信号滤波器"
    default n
    help
        一阶高通滤波器

config DUST_FLT_KALMAN
    bool "Kalman filter"
    default n
    select DUST_MATH_EIGEN
    help
        模板化通用线性 Kalman 滤波器，固定尺寸编译期优化。

config DUST_FLT_KALMAN_EKF
    bool "ExtendedKalman template"
    default n
    select DUST_MATH_EIGEN
    help
        模板化扩展卡尔曼滤波器（EKF），使用 SystemFunc/ObserveFunc
        回调替代 Hook 模式，固定尺寸编译期优化。

config DUST_FLT_LPF
    bool "信号滤波器"
    default n
    help
        一阶低通滤波器

config DUST_FLT_QUATERNION
    bool "Quaternion attitude EKF"
    default n
    select DUST_FLT_KALMAN_EKF
    help
        基于四元数的 IMU 姿态解算 EKF。
        内部使用 ExtendedKalman<6, 3, 3> 作为滤波引擎。

config DUST_ID_RLS
    bool "递归最小二乘法"
    default n
    select DUST_MATH_EIGEN
    help
        递归最小二乘法

config DUST_ID_MOTOR_PLANT
    bool "电机本体辨识"
    default n
    select DUST_ID_RLS
    help
        基于 RLS 的电机本体辨识（torque→omega）。
        输出离散模型 a/b/c 和连续域 K/τ/delay。

config DUST_ID_STABILITY
    bool "稳定判据与波形发生器"
    default n
    help
        滑动窗口稳定判据 + 方波/三角波/正弦波发生器。
        header-only，无依赖。

config DUST_MATH_EIGEN
    bool "Eigen 线性代数库"
    default n
    help
        Eigen 5 header-only 线性代数库，提供矩阵/向量运算。
        其他算法模块可通过 select DUST_MATH_EIGEN 自动启用。

config DUST_MOD_CTL_POWER
    bool "功率控制器"
    default n
    select DUST_CTL_PID
    select DUST_ID_RLS
    select DUST_FLT_LPF
    help
        电机功率控制，包含功率模型预测/RLS参数辨识/隶属度分配/受限力矩求解
```

## framework/drivers/Kconfig
```kconfig
# drivers/Kconfig - 底层硬件驱动抽象
# 提供 GPIO/PWM/UART/CAN 等外设驱动，以及 printk/shell 调试通道
# 每个 config 直接 select 对应的 Zephyr 子系统驱动符号

config DUST_DEV_GPIO_OUTPUT
    default n
    bool "Enable GPIO output wrapper"
    select GPIO
    help
        Enable the GPIO output wrappers in drivers/device/gpio.

config DUST_DEV_GPIO_INPUT
    default n
    bool "Enable GPIO input wrapper"
    select GPIO
    help
        Enable the GPIO input wrappers in drivers/device/gpio.

config DUST_DEV_PWM
    default n
    bool "Enable simple PWM device wrapper"
    select PWM
    help
        Enable the lightweight PWM wrapper in drivers/device/pwm.

config DUST_COM_UART
    default n
    bool "UART interrupt driver"
    select SERIAL
    select UART_INTERRUPT_DRIVEN
    select UART_ASYNC_API
    select DUST_BUF_BIPBUF
    help
        Enable the UART interrupt driver with ping-pong receive buffering.

config DUST_COM_UART_DMA
    default n
    bool "UART DMA driver"
    select SERIAL
    select UART_ASYNC_API
    select DUST_BUF_BIPBUF
    help
        Enable the asynchronous DMA UART driver.

config DUST_COM_SPI
    default n
    bool "SPI driver"
    select SPI
    select GPIO
    help
        Enable the lightweight SPI wrapper in drivers/communication/spi.

config DUST_COM_CAN
    default n
    bool "CAN driver"
    select CAN
    help
        Enable the CAN driver. Board DTS must provide the CAN controller node.

config DUST_COM_RS485
    default n
    bool "RS485 half-duplex driver"
    select SERIAL
    select UART_ASYNC_API
    select GPIO
    help
        Enable the RS485 half-duplex driver using UART_ASYNC_API and a DE/RE GPIO.

config DUST_COM_USB
    default n
    bool "USB CDC ACM driver"
    select DUST_BUF_BIPBUF
    select DUST_USB_DEVICE_STACK
    help
        Enable the C++ USB device CDC ACM stream.
```

## framework/modules/Kconfig
```kconfig
# modules/Kconfig - hardware-facing modules built on top of drivers/topics

config DUST_MOD_DEV_IMU
    bool "IMU module"
    default n
    select DUST_FLT_QUATERNION
    select DUST_TPC_IMU_TO
    select DUST_CTL_TIMER
    select DUST_ID_STABILITY
    help
        IMU source decoupling, attitude EKF and zbus publish layer.

config DUST_MOD_DEV_IMU_HEATER
    bool "IMU heater (PWM + PID)"
    default y if DUST_MOD_DEV_IMU_BMI088 || DUST_MOD_DEV_IMU_ICM42688P
    depends on DUST_MOD_DEV_IMU
    select DUST_DEV_PWM
    select DUST_CTL_PID
    help
        裸传感器（BMI088 / ICM42688P）的 PWM + PID 恒温加热器。
        默认随裸传感器一起打开；想先单独验证 IMU 通信时，在 prj.conf 里
        写 CONFIG_DUST_MOD_DEV_IMU_HEATER=n 即可（加热器不初始化、不更新 PWM，
        IMU 采样/校准/解算照常）。自带封装且无加热器的成品模块（如 HiPNUC）
        不选本项，ImuManager 会跳过加热器初始化与预热。

config DUST_MOD_DEV_IMU_BMI088
    bool "BMI088 IMU source"
    default n
    depends on DUST_MOD_DEV_IMU
    select DUST_COM_SPI
    select SPI_STM32_DMA
    help
        BMI088 source implementation for the IMU module.

config DUST_MOD_DEV_IMU_ICM42688P
    bool "ICM42688P IMU source"
    default n
    depends on DUST_MOD_DEV_IMU
    select DUST_COM_SPI
    help
        ICM42688P source implementation for the IMU module.

config DUST_MOD_DEV_IMU_HIPNUC
    bool "HiPNUC IMU source"
    default n
    depends on DUST_MOD_DEV_IMU
    select DUST_COM_UART_DMA
    help
        HiPNUC HI 系列串口 IMU（0x5A 0xA5 帧头 / 0x91 组合数据帧）。
        模块自带姿态融合，直接输出欧拉角与四元数，上层旁路 EKF；
        无加热器，也不做驱动侧零偏采集。

config DUST_MOD_DEV_IMU_HIPNUC_CRC
    bool "HiPNUC frame CRC16 check"
    default n
    depends on DUST_MOD_DEV_IMU_HIPNUC
    help
        对 0x91 数据帧做 CRC16 校验（poly 0x1021，init 0xFFFF）。
        需与模块固件 / 旧驱动 CRC.h 的多项式一致；不一致时保持 n，
        仅用 0x5A 0xA5 帧头 + LEN + tag 做结构校验。

config DUST_MOD_DEV_IMU_IDENT
    bool "IMU open-loop identification"
    default n
    depends on DUST_MOD_DEV_IMU
    select DUST_ID_STABILITY
    select DUST_COM_UART_DMA
    select DUST_MOD_DEV_IMU_HEATER
    help
        IMU heater duty-step open-loop identification.

config DUST_MOD_DEV_MOTOR_DJI
    bool "DJI motor"
    default n
    select DUST_COM_CAN
    help
        DJI motor module.

config DUST_MOD_DEV_MOTOR_DM
    bool "DM motor"
    default n
    select DUST_COM_CAN
    help
        DM motor module.

config DUST_MOD_DEV_POWERMETER
    bool "Horizon power meter"
    default n
    select DUST_COM_CAN
    help
        Horizon power meter module.

config DUST_MOD_DEV_REMOTE
    bool "Remote receiver"
    default n
    select DUST_COM_UART_DMA
    select DUST_TPC_REMOTE_TO
    help
        Remote receiver module.

config DUST_MOD_DEV_REMOTE_DUAL
    bool "Dual remote support"
    default n
    depends on DUST_MOD_DEV_REMOTE
    help
        Enable two independent remote receiver instances.

config DUST_MOD_DEV_REMOTE_AUTO
    bool "Auto link all protocols"
    default n
    depends on DUST_MOD_DEV_REMOTE
    help
        Automatically link all available protocol sources.

config DUST_MOD_DEV_REMOTE_DR16
    bool "DR16 protocol"
    default n
    depends on DUST_MOD_DEV_REMOTE
    help
        DR16 remote protocol.

config DUST_MOD_DEV_REMOTE_SBUS
    bool "SBUS protocol"
    default n
    depends on DUST_MOD_DEV_REMOTE
    help
        SBUS remote protocol.

config DUST_MOD_DEV_REMOTE_VT12
    bool "VT12 protocol"
    default n
    depends on DUST_MOD_DEV_REMOTE
    help
        VT12 remote protocol (mouse + keyboard).

config DUST_MOD_DEV_REMOTE_VT13
    bool "VT13 protocol"
    default n
    depends on DUST_MOD_DEV_REMOTE
    help
        VT13 remote protocol (full-featured).
```

## framework/topic/Kconfig
```kconfig
# topic/Kconfig - inter-thread data channels

config DUST_TPC_TO_CAN_TX
    default n
    bool "CAN TX queue"
    help
        CAN transmit message queue.

config DUST_TPC_REMOTE_TO
    default n
    bool "Remote channel"
    select ZBUS
    help
        Remote data zbus channel.

config DUST_TPC_IMU_TO
    default n
    bool "IMU channel"
    select ZBUS
    help
        IMU data zbus channel.
```
